## embedded/main/kconfig.projbuild
```kconfig
menu "Project Configuration"
    config WIFI_SSID
            string "WIFI SSID"
            default "myssid"
            help
                SSID (network name) for us to connect to.

    config WIFI_PASSWORD
            string "WiFi Password"
            default "mypassword"
            help
                WiFi password (WPA or WPA2) to connect to.
    config SERVER_IP
            string "Server IP"
            default "localhost"
            help 
                Server IP address to connect to.

    config SERVER_PORT
            string "Server Port"
            default "1234"
            help 
                Server port to connect to.
endmenu
```
